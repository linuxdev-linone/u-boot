## arch/arm/mach-rockchip/rk322x/Kconfig
```kconfig
if ROCKCHIP_RK322X


config TARGET_EVB_RK3229
	bool "EVB_RK3229"
	select BOARD_LATE_INIT

config TARGET_G1_THINCLIENT_PC_RK3229
	bool "G1_THINCLIENT_PC_RK3229"
	select HAS_ROM
	select BOARD_LATE_INIT

config ROCKCHIP_BOOT_MODE_REG
	default 0x110005c8

config ROCKCHIP_STIMER_BASE
	default 0x110d0020

config SYS_SOC
	default "rk322x"

config SYS_MALLOC_F_LEN
	default 0x800

config SPL_LIBCOMMON_SUPPORT
	default y

config SPL_LIBGENERIC_SUPPORT
	default y

config SPL_SERIAL
	default y

config TPL_STACK
        default 0x10088000

config TPL_TEXT_BASE
        default 0x10081000

source "board/rockchip/evb_rk3229/Kconfig"
source "board/rockchip/g1_thinclient_pc_rk3229/Kconfig"

endif
```

## board/rockchip/g1_thinclient_pc_rk3229/Kconfig
```kconfig
if TARGET_G1_THINCLIENT_PC_RK3229

config SYS_BOARD
	default "g1_thinclient_pc_rk3229"

config SYS_VENDOR
	default "rockchip"

config SYS_CONFIG_NAME
	default "g1_thinclient_pc_rk3229"

config BOARD_SPECIFIC_OPTIONS # dummy
	def_bool y

endif
```
